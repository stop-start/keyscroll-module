#include <behaviors.dtsi>
#include <dt-bindings/zmk/keys.h>
#include <dt-bindings/zmk/bt.h>

/ {
    keymap {
        compatible = "zmk,keymap";

        default_layer {
            bindings = <
                &kp LC(Z)      // Button 1 → types 'A' (test)
                &kp G      // Button 2 → types 'B'
		&bt BT_CLR_ALL // BT_SEL 0

            >;
	    sensor-bindings = <&inc_dec_kp EQUAL MINUS>;
        };
    };
};
